## CMakeLists.txt
```
cmake_minimum_required(VERSION 3.20.0)
find_package(Zephyr REQUIRED HINTS $ENV{ZEPHYR_BASE})
project(sp1-looper)
include(${ZEPHYR_BASE}/samples/subsys/usb/common/common.cmake)
target_sources(app PRIVATE src/main.c src/sp1_emmc.c)

# -fno-strict-aliasing: the firmware type-puns static uint8_t[] storage through
# int16_t* / struct* lvalues (the batchbuf copies and the meta-block cast). This
# removes the TBAA assumption so those puns stay correct under -O2 -- the same
# idiom the Linux kernel and Zephyr core build with. Purely subtractive; it can
# only remove an optimizer assumption, never miscompile correct code.
target_compile_options(app PRIVATE -fno-strict-aliasing)

# NOTE: -O2 on sp1_emmc.c was REVERTED. It sped up reads but BROKE the timing-
# sensitive flash WRITE bit-bang -- ~half of writes failed CRC and retried, which
# overflowed the record ring under record+play load (corruption/glitching). The
# eMMC driver stays at the global -Os, where the write timing is correct.
```

## prj.conf
```kconfig
CONFIG_PM=y
CONFIG_PM_DEVICE=n
CONFIG_LOG=n
CONFIG_ASSERT=n
CONFIG_USE_SEGGER_RTT=n
CONFIG_IDLE_STACK_SIZE=128
CONFIG_ISR_STACK_SIZE=512
CONFIG_WATCHDOG=y

# ---- FAILSAFES: catch stack overflow / bad memory access cleanly (MPU guard +
# stack canary). Any fatal fault is turned into a reboot by k_sys_fatal_error_handler
# in main.c, and the 4 s watchdog is the final backstop for a hang. ----
CONFIG_HW_STACK_PROTECTION=y
CONFIG_STACK_SENTINEL=y
CONFIG_REBOOT=y
CONFIG_CLOCK_CONTROL=y
CONFIG_CLOCK_CONTROL_NRF_K32SRC_SYNTH=y

# ---- USB-serial diagnostics console (CDC ACM) ----
CONFIG_PRINTK=y
CONFIG_SERIAL=y
CONFIG_CONSOLE=y
CONFIG_UART_CONSOLE=y
CONFIG_UART_LINE_CTRL=y
CONFIG_UART_INTERRUPT_DRIVEN=y

# ---- Milestone 3: USB-C audio IN (UAC2) on the new device_next USB stack ----
# UAC2 only exists on the new stack, which is mutually exclusive with the legacy
# CONFIG_USB_DEVICE_STACK. The CDC console therefore moves to device_next too and
# enumerates as a composite (UAC2 speaker + CDC ACM) device.
CONFIG_USB_DEVICE_STACK_NEXT=y
CONFIG_USBD_AUDIO2_CLASS=y
CONFIG_USBD_CDC_ACM_CLASS=y
# SOF events drive the explicit-feedback regulator (sof_cb / feedback_cb).
CONFIG_UDC_ENABLE_SOF=y
# The app owns the single composite USBD context; do NOT let the CDC SYS_INIT
# build a second private context that would fight for the controller.
CONFIG_CDC_ACM_SERIAL_INITIALIZE_AT_BOOT=n
# Serial-number string descriptor.
CONFIG_HWINFO=y
# Composite device identity (replaces the legacy VID/PID/strings). New PID so a
# host does not reuse a cached CDC-only driver from the old firmware.
CONFIG_SAMPLE_USBD_VID=0x1915
CONFIG_SAMPLE_USBD_PID=0x5210
CONFIG_SAMPLE_USBD_MANUFACTURER="softmodded"
CONFIG_SAMPLE_USBD_PRODUCT="SP-1 Audio"
# WINDOWS: usbaudio2.sys demands a 4-byte Full-Speed feedback endpoint (the
# USB spec says 3) and a Q16.16 value — without this the device enumerates
# with a yellow triangle / Code 10 ("cannot start") on Windows. Linux and
# macOS parse the format from the declared size, so this is host-universal.
# (Backported into the Zephyr tree; upstream: USBD_UAC2_FS_WINDOWS_WORKAROUND,
# zephyrproject-rtos/zephyr issue #77212.)
CONFIG_USBD_UAC2_FS_WINDOWS_WORKAROUND=y
# CPU forensics: per-thread cycle accounting for the CPU= diag field
CONFIG_THREAD_RUNTIME_STATS=y
CONFIG_SCHED_THREAD_USAGE=y
# iOS: iPhones/iPads reject accessories claiming more than 100 mA over the
# camera adapter. The SP-1 runs from its own battery and barely sips the bus,
# so claim 100 mA (units of 2 mA) instead of the 250 mA default.
CONFIG_SAMPLE_USBD_MAX_POWER=50

# ---- ADC for the button ladders / faders ----
CONFIG_ADC=y

# ---- Milestone 2: I2C to the audio codecs (CS42L42 / TAS2505) ----
CONFIG_I2C=y

# ---- Milestone 2b: I2S audio out (nRF master) ----
CONFIG_I2S=y
CONFIG_I2S_NRFX=y
CONFIG_FPU=y
# NOTE: deliberately NOT setting CONFIG_SPEED_OPTIMIZATIONS=y (-O2). It crashed the
# device on hardware -- this ae5b2e8-derived code has latent signed-overflow UB in
# the mixer interp that -O2 weaponizes. Default -Os is stable. Re-enabling -O2 would
# require fixing that UB (int64 interp) FIRST. Stay on -Os.

# USB stack + printf need a roomier main stack than the bare power build;
# device_next USBD init (descriptor build + class registration) wants headroom.
CONFIG_MAIN_STACK_SIZE=4096

# ---- Always-dim LEDs (fork): the soft-PWM LED timer ISR runs as a ZERO-
# LATENCY interrupt so kernel locks / other IRQs can't delay its on/off edges
# (edge jitter at low duty = visible flicker). The ISR is pure register IO. ----
CONFIG_ZERO_LATENCY_IRQS=y
```

## src/sp1_dma_wait.h
```c
#ifndef SP1_DMA_WAIT_H
#define SP1_DMA_WAIT_H
#include <stdint.h>
#include <stdbool.h>
/* Caller supplies a wrapping monotonic cycle counter. Re-read END after the
 * deadline check: the thread may have been preempted while DMA completed. */
static inline bool sp1_dma_wait(volatile uint32_t *end,
                              volatile uint32_t *stop,
                              volatile uint32_t *stopped,
                              volatile uint32_t *enable,
                              uint32_t (*now)(void), uint32_t limit,
                              uint32_t stop_limit)
{
 uint32_t start=now();
 while (!*end && (uint32_t)(now()-start)<limit) {}
 bool done=*end!=0;
 if (!done) {
  *stopped=0; *stop=1; start=now();
  while (!*stopped && (uint32_t)(now()-start)<stop_limit) {}
 }
 *enable=0;
 return done;
}
#endif
```

## src/sp1_emmc.h
```c
/*
 * SP-1 eMMC 1-bit bit-bang driver (Zephyr port of Tim Knapen's SP-1-dev emmc.c).
 * Toshiba THGBMNG5D1LBAIL, 4 GB, connected CLK/CMD/DAT0/RST_n + VCCQ only.
 * Ported to use the nrfx GPIO HAL + k_busy_wait so it builds in the Zephyr app.
 * The DATA-phase clock half-period is runtime-configurable (g_emmc_clk_half_us);
 * the firmware sets it to 0 (delay-free, fastest) after init. Commands/init
 * always use a fixed safe clock internally.
 */
#ifndef SP1_EMMC_H
#define SP1_EMMC_H

#include <stdint.h>
#include <stdbool.h>

/* Build selector (the only knob that differs between the two builds).
 *   0 = 48 kHz: flash bus at 32 MHz (M32), full rate.
 *   1 = 24 kHz: flash bus at the in-spec 16 MHz (M16). Half the data rate gives
 *       ~2x bandwidth headroom, so it stays rock-solid under a full 4-track load.
 *       The 32 MHz overclock (over the eMMC's 26 MHz spec) was what made an earlier
 *       24 kHz build glitch into white noise; M16 cures it. Both builds keep the
 *       eMMC write cache ON (it absorbs record bursts so writes don't stall the bus
 *       and crackle the playing tracks).
 * It drives DECIM (sample rate) and the SPIM flash clock. */
#ifndef SP1_BUILD_24K
#define SP1_BUILD_24K 0
#endif

#define EMMC_BLOCK_SIZE 512u

/* DATA-transfer clk half-period in microseconds. 0 = fastest (no busy-wait, just
 * GPIO register toggles); the streamer sets 0 after emmc_init(). Commands/init
 * always use a fixed safe clock internally. */
extern volatile uint32_t g_emmc_clk_half_us;
extern volatile uint32_t emmc_crc_rd_errs;   /* verified-read CRC catches  */
extern volatile uint32_t emmc_crc_wr_errs;   /* write status-token catches */

/* ---- diagnostics, filled by emmc_init() to pinpoint where bring-up fails ---- */
extern bool    emmc_dbg_cmd0_sent;
extern int     emmc_dbg_cmd1_retries;   /* retries until ready; -1 = never ready */
extern bool    emmc_dbg_cmd2_resp;
extern bool    emmc_dbg_cmd3_resp;
extern bool    emmc_dbg_cmd7_resp;
extern bool    emmc_dbg_cmd16_resp;
extern uint8_t emmc_dbg_ocr[6];          /* CMD1 R3 response bytes */
extern uint8_t emmc_dbg_r1[6];           /* CMD7 R1 response bytes */
/* Last single-block read/write command response flags (for read/write tests). */
extern bool    emmc_dbg_last_cmd_resp;
extern int     emmc_dbg_resp_clocks;   /* clocks until last response start bit (-1=none) */
extern int     emmc_dbg_cmd2_clocks;   /* clocks-to-response captured for CMD2 (-1=none) */
extern int     emmc_dbg_cmd2_tries;    /* CMD2 attempts before a response */
extern int     emmc_dbg_wr_status;     /* CRC status token from last block write:
					* 0b010=2 accepted, 0b101=5 CRC err, 0b110=6 write err, -1=none */
extern uint16_t emmc_dbg_rd_crc;
extern volatile uint32_t emmc_dbg_wr_busy_max;  /* diag: max post-write program busy-wait clk iterations */       /* CRC16 the card appended to the last read block */
/* Wall-clock stall diagnostics (us). THE numbers the crackle hunt needs: the
 * old iteration counters were uncalibrated and their silent expiry hid the
 * true stall length. window = reset by the diag printer; peak = session max. */
extern volatile uint32_t emmc_dbg_wr_busy_us_max;    /* worst write program-busy, us (window) */
extern volatile uint32_t emmc_dbg_wr_busy_us_peak;   /* worst write program-busy, us (session) */
extern volatile uint32_t emmc_dbg_rd_wait_us_max;    /* worst read start-bit access wait, us (window) */
extern volatile uint32_t emmc_dbg_switch_busy_us_max;/* worst R1b busy: CMD6 flush/BKOPS/TRIM, us */
extern volatile uint32_t emmc_dbg_busy_timeouts;     /* busy-poll expiries (SEPARATE from CRC errs) */
extern volatile uint32_t emmc_dbg_hpi_fires;         /* HPI aborts issued (maintenance ops cut short) */


bool emmc_init(void);
bool emmc_is_ready(void);
bool emmc_cmd13(uint8_t *r1_out);      /* SEND_STATUS — card status register R1 */
bool emmc_read_ext_csd(uint8_t *buf);  /* CMD8 SEND_EXT_CSD -> 512-byte EXT_CSD (read-only) */
bool emmc_cache_enable(void);          /* EXT_CSD CACHE_CTRL=1 (volatile write cache on) */
bool emmc_cache_flush(void);           /* EXT_CSD FLUSH_CACHE=1 (program cache to NAND) */
/* FTL-maintenance ops (eMMC 4.5+/5.0). ALL fail-safe: gate on the EXT_CSD
 * support bytes and treat any false return as "carry on without". */
bool emmc_trim(uint32_t start_blk, uint32_t end_blk, uint32_t busy_us);
bool emmc_cache_flush_try(void);       /* ABORTABLE flush for mid-session idle windows (needs HPI) */
bool emmc_hpi_enable(void);            /* EXT_CSD HPI_MGMT[161]=1; gate on HPI_FEATURES[503] bit0 */
void emmc_set_abort_cb(bool (*cb)(void)); /* busy-abort hook polled by abortable R1b waits */
bool emmc_bkops_auto_enable(void);     /* EXT_CSD[163] |= AUTO_EN (SET-BITS; reversible, never touches OTP MANUAL_EN) */
bool emmc_pon_powered_on(void);        /* EXT_CSD[34]=1 POWERED_ON (boot) */
bool emmc_pon_power_off_short(void);   /* EXT_CSD[34]=2 POWER_OFF_SHORT (shutdown, after the cache flush) */
bool emmc_read_blocks(uint32_t block_addr, uint8_t *buf, uint32_t count);
bool emmc_spim_active(void);           /* diag: true = 32MHz SPIM3 DMA path live, false = bit-bang */
bool emmc_write_blocks(uint32_t block_addr, const uint8_t *buf, uint32_t count);

#endif /* SP1_EMMC_H */
```
